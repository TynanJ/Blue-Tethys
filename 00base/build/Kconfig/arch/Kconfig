## 00base/build/Kconfig/arch/Kconfig
```kconfig
# Load Zephyr Arch Kconfig descriptions.
osource "/home/tynan/csse4011/zephyr/arch/rx/Kconfig"
osource "/home/tynan/csse4011/zephyr/arch/x86/Kconfig"
osource "/home/tynan/csse4011/zephyr/arch/xtensa/Kconfig"
osource "/home/tynan/csse4011/zephyr/arch/sparc/Kconfig"
osource "/home/tynan/csse4011/zephyr/arch/riscv/Kconfig"
osource "/home/tynan/csse4011/zephyr/arch/posix/Kconfig"
osource "/home/tynan/csse4011/zephyr/arch/mips/Kconfig"
osource "/home/tynan/csse4011/zephyr/arch/arm64/Kconfig"
osource "/home/tynan/csse4011/zephyr/arch/arm/Kconfig"
osource "/home/tynan/csse4011/zephyr/arch/arc/Kconfig"
```

## 00base/build/Kconfig/boards/Kconfig
```kconfig
# Load Zephyr board Kconfig descriptions.
osource "/Users/piperhofstee/csse4011/zephyr/boards/seeed/xiao_ble/Kconfig"
```

## 00base/build/Kconfig/boards/Kconfig.defconfig
```kconfig
# Load Zephyr board defconfig descriptions.
osource "/Users/piperhofstee/csse4011/zephyr/boards/seeed/xiao_ble/Kconfig.defconfig"
```

## 00base/build/Kconfig/boards/Kconfig.sysbuild
```kconfig
# Load Sysbuild board Kconfig descriptions.
osource "/home/tynan/csse4011/zephyr/boards/seeed/xiao_ble/Kconfig.sysbuild"
```

## 01mobileIMU/build/Kconfig/boards/Kconfig
```kconfig
# Load Zephyr board Kconfig descriptions.
osource "/home/tynan/csse4011/zephyr/boards/seeed/xiao_ble/Kconfig"
```

## basestation/build/Kconfig/soc/Kconfig
```kconfig
# Load Zephyr SoC Kconfig descriptions.
osource "/Users/piperhofstee/csse4011/zephyr/soc/xlnx/zynqmp/Kconfig"
osource "/Users/piperhofstee/csse4011/zephyr/soc/xlnx/zynq7000/Kconfig"
osource "/Users/piperhofstee/csse4011/zephyr/soc/xlnx/versalnet/Kconfig"
osource "/Users/piperhofstee/csse4011/zephyr/soc/xlnx/versal2/Kconfig"
osource "/Users/piperhofstee/csse4011/zephyr/soc/xen/Kconfig"
osource "/Users/piperhofstee/csse4011/zephyr/soc/wch/ch32v/Kconfig"
osource "/Users/piperhofstee/csse4011/zephyr/soc/ti/simplelink/Kconfig"
osource "/Users/piperhofstee/csse4011/zephyr/soc/ti/mspm0/Kconfig"
osource "/Users/piperhofstee/csse4011/zephyr/soc/ti/lm3s6965/Kconfig"
osource "/Users/piperhofstee/csse4011/zephyr/soc/ti/k3/Kconfig"
osource "/Users/piperhofstee/csse4011/zephyr/soc/telink/tlsr/Kconfig"
osource "/Users/piperhofstee/csse4011/zephyr/soc/starfive/jh71xx/Kconfig"
osource "/Users/piperhofstee/csse4011/zephyr/soc/st/stm32/Kconfig"
osource "/Users/piperhofstee/csse4011/zephyr/soc/snps/qemu_arc/Kconfig"
osource "/Users/piperhofstee/csse4011/zephyr/soc/snps/nsim/arc_v/Kconfig"
osource "/Users/piperhofstee/csse4011/zephyr/soc/snps/nsim/arc_classic/Kconfig"
osource "/Users/piperhofstee/csse4011/zephyr/soc/snps/hsdk4xd/Kconfig"
osource "/Users/piperhofstee/csse4011/zephyr/soc/snps/hsdk/Kconfig"
osource "/Users/piperhofstee/csse4011/zephyr/soc/snps/emsk/Kconfig"
osource "/Users/piperhofstee/csse4011/zephyr/soc/snps/emsdp/Kconfig"
osource "/Users/piperhofstee/csse4011/zephyr/soc/snps/arc_iot/Kconfig"
osource "/Users/piperhofstee/csse4011/zephyr/soc/silabs/Kconfig"
osource "/Users/piperhofstee/csse4011/zephyr/soc/sifli/sf32/Kconfig"
osource "/Users/piperhofstee/csse4011/zephyr/soc/sifive/sifive_freedom/Kconfig"
osource "/Users/piperhofstee/csse4011/zephyr/soc/sensry/Kconfig"
osource "/Users/piperhofstee/csse4011/zephyr/soc/rockchip/Kconfig"
osource "/Users/piperhofstee/csse4011/zephyr/soc/renode/riscv_virtual/Kconfig"
osource "/Users/piperhofstee/csse4011/zephyr/soc/renode/cortex_r8_virtual/Kconfig"
osource "/Users/piperhofstee/csse4011/zephyr/soc/renesas/smartbond/Kconfig"
osource "/Users/piperhofstee/csse4011/zephyr/soc/renesas/rz/Kconfig"
osource "/Users/piperhofstee/csse4011/zephyr/soc/renesas/rx/Kconfig"
osource "/Users/piperhofstee/csse4011/zephyr/soc/renesas/rcar/Kconfig"
osource "/Users/piperhofstee/csse4011/zephyr/soc/renesas/ra/Kconfig"
osource "/Users/piperhofstee/csse4011/zephyr/soc/realtek/ec/Kconfig"
osource "/Users/piperhofstee/csse4011/zephyr/soc/raspberrypi/rpi_pico/Kconfig"
osource "/Users/piperhofstee/csse4011/zephyr/soc/quicklogic/eos_s3/Kconfig"
osource "/Users/piperhofstee/csse4011/zephyr/soc/qemu/virt_riscv/Kconfig"
osource "/Users/piperhofstee/csse4011/zephyr/soc/qemu/malta/Kconfig"
osource "/Users/piperhofstee/csse4011/zephyr/soc/openisa/rv32m1/Kconfig"
osource "/Users/piperhofstee/csse4011/zephyr/soc/openhwgroup/cva6/Kconfig"
osource "/Users/piperhofstee/csse4011/zephyr/soc/oct/osd32mp15x/Kconfig"
osource "/Users/piperhofstee/csse4011/zephyr/soc/nxp/s32/Kconfig"
osource "/Users/piperhofstee/csse4011/zephyr/soc/nxp/rw/Kconfig"
osource "/Users/piperhofstee/csse4011/zephyr/soc/nxp/mcx/Kconfig"
osource "/Users/piperhofstee/csse4011/zephyr/soc/nxp/lpc/Kconfig"
osource "/Users/piperhofstee/csse4011/zephyr/soc/nxp/layerscape/Kconfig"
osource "/Users/piperhofstee/csse4011/zephyr/soc/nxp/kinetis/Kconfig"
osource "/Users/piperhofstee/csse4011/zephyr/soc/nxp/imxrt/Kconfig"
osource "/Users/piperhofstee/csse4011/zephyr/soc/nxp/imx/Kconfig"
osource "/Users/piperhofstee/csse4011/zephyr/soc/nuvoton/numicro/Kconfig"
osource "/Users/piperhofstee/csse4011/zephyr/soc/nuvoton/numaker/Kconfig"
osource "/Users/piperhofstee/csse4011/zephyr/soc/nuvoton/npcx/Kconfig"
osource "/Users/piperhofstee/csse4011/zephyr/soc/nuvoton/npcm/Kconfig"
osource "/Users/piperhofstee/csse4011/zephyr/soc/nordic/Kconfig"
osource "/Users/piperhofstee/csse4011/zephyr/soc/neorv32/Kconfig"
osource "/Users/piperhofstee/csse4011/zephyr/soc/native/inf_clock/Kconfig"
osource "/Users/piperhofstee/csse4011/zephyr/soc/microchip/sam/Kconfig"
osource "/Users/piperhofstee/csse4011/zephyr/soc/microchip/sam/sama7/Kconfig"
osource "/Users/piperhofstee/csse4011/zephyr/soc/microchip/sam/sam_d5x_e5x/Kconfig"
osource "/Users/piperhofstee/csse4011/zephyr/soc/microchip/pic32c/pic32cz_ca/Kconfig"
osource "/Users/piperhofstee/csse4011/zephyr/soc/microchip/pic32c/pic32cx_sg/Kconfig"
osource "/Users/piperhofstee/csse4011/zephyr/soc/microchip/pic32c/pic32cm_jh/Kconfig"
osource "/Users/piperhofstee/csse4011/zephyr/soc/microchip/miv/Kconfig"
osource "/Users/piperhofstee/csse4011/zephyr/soc/microchip/mec/Kconfig"
osource "/Users/piperhofstee/csse4011/zephyr/soc/mediatek/mt8xxx/Kconfig"
osource "/Users/piperhofstee/csse4011/zephyr/soc/lowrisc/opentitan/Kconfig"
osource "/Users/piperhofstee/csse4011/zephyr/soc/litex/litex_vexriscv/Kconfig"
osource "/Users/piperhofstee/csse4011/zephyr/soc/ite/ec/Kconfig"
osource "/Users/piperhofstee/csse4011/zephyr/soc/intel/raptor_lake/Kconfig"
osource "/Users/piperhofstee/csse4011/zephyr/soc/intel/panther_lake/Kconfig"
osource "/Users/piperhofstee/csse4011/zephyr/soc/intel/lakemont/Kconfig"
osource "/Users/piperhofstee/csse4011/zephyr/soc/intel/intel_socfpga_std/Kconfig"
osource "/Users/piperhofstee/csse4011/zephyr/soc/intel/intel_socfpga/Kconfig"
osource "/Users/piperhofstee/csse4011/zephyr/soc/intel/intel_niosv/Kconfig"
osource "/Users/piperhofstee/csse4011/zephyr/soc/intel/intel_ish/Kconfig"
osource "/Users/piperhofstee/csse4011/zephyr/soc/intel/intel_adsp/Kconfig"
osource "/Users/piperhofstee/csse4011/zephyr/soc/intel/elkhart_lake/Kconfig"
osource "/Users/piperhofstee/csse4011/zephyr/soc/intel/atom/Kconfig"
osource "/Users/piperhofstee/csse4011/zephyr/soc/intel/apollo_lake/Kconfig"
osource "/Users/piperhofstee/csse4011/zephyr/soc/intel/alder_lake/Kconfig"
osource "/Users/piperhofstee/csse4011/zephyr/soc/infineon/edge/Kconfig"
osource "/Users/piperhofstee/csse4011/zephyr/soc/infineon/cat3/Kconfig"
osource "/Users/piperhofstee/csse4011/zephyr/soc/infineon/cat1c/Kconfig"
osource "/Users/piperhofstee/csse4011/zephyr/soc/infineon/cat1b/Kconfig"
osource "/Users/piperhofstee/csse4011/zephyr/soc/infineon/cat1a/Kconfig"
osource "/Users/piperhofstee/csse4011/zephyr/soc/gd/gd32/Kconfig"
osource "/Users/piperhofstee/csse4011/zephyr/soc/gaisler/leon3/Kconfig"
osource "/Users/piperhofstee/csse4011/zephyr/soc/gaisler/gr716a/Kconfig"
osource "/Users/piperhofstee/csse4011/zephyr/soc/espressif/Kconfig"
osource "/Users/piperhofstee/csse4011/zephyr/soc/ene/kb1200/Kconfig"
osource "/Users/piperhofstee/csse4011/zephyr/soc/ene/kb106x/Kconfig"
osource "/Users/piperhofstee/csse4011/zephyr/soc/egis/Kconfig"
osource "/Users/piperhofstee/csse4011/zephyr/soc/efinix/sapphire/Kconfig"
osource "/Users/piperhofstee/csse4011/zephyr/soc/cdns/xtensa_sample_controller/Kconfig"
osource "/Users/piperhofstee/csse4011/zephyr/soc/cdns/sample_controller32/Kconfig"
osource "/Users/piperhofstee/csse4011/zephyr/soc/cdns/dc233c/Kconfig"
osource "/Users/piperhofstee/csse4011/zephyr/soc/brcm/bcmvk/Kconfig"
osource "/Users/piperhofstee/csse4011/zephyr/soc/brcm/bcm2712/Kconfig"
osource "/Users/piperhofstee/csse4011/zephyr/soc/brcm/bcm2711/Kconfig"
osource "/Users/piperhofstee/csse4011/zephyr/soc/bflb/Kconfig"
osource "/Users/piperhofstee/csse4011/zephyr/soc/atmel/sam0/Kconfig"
osource "/Users/piperhofstee/csse4011/zephyr/soc/atmel/sam/Kconfig"
osource "/Users/piperhofstee/csse4011/zephyr/soc/aspeed/Kconfig"
osource "/Users/piperhofstee/csse4011/zephyr/soc/arm/Kconfig"
osource "/Users/piperhofstee/csse4011/zephyr/soc/arm/beetle/Kconfig"
osource "/Users/piperhofstee/csse4011/zephyr/soc/antmicro/myra/Kconfig"
osource "/Users/piperhofstee/csse4011/zephyr/soc/andestech/Kconfig"
osource "/Users/piperhofstee/csse4011/zephyr/soc/amd/acp_6_0/Kconfig"
osource "/Users/piperhofstee/csse4011/zephyr/soc/ambiq/Kconfig"
osource "/Users/piperhofstee/csse4011/zephyr/soc/aesc/Kconfig"
osource "/Users/piperhofstee/csse4011/zephyr/soc/adi/max32/Kconfig"
```

## drivers/sensor/csse4011_tmp36/Kconfig
```kconfig
config CSSE4011_TMP36
    bool "CSSE4011 TMP36 temperature sensor driver"
    default n
    select SENSOR
    select ADC
    help
      Enable support for the TMP36 analog temperature sensor.
      This driver uses the ADC subsystem to read temperature values.
```

## dts/bindings/csse4011,tmp36.yaml
```yaml
# Copyright (c) 2024, Adrien Leravat
# SPDX-License-Identifier: Apache-2.0

description: TMP36 analog temperature sensor

compatible: "csse4011,tmp36"

include: base.yaml

properties:
  io-channels:
    type: phandle-array
    required: true
    description: |
      ADC channel used to read the TMP36 output voltage.
      This should be of the form <&adc channel>.

  io-channel-names:
    type: string-array
    required: false

  channel:
    type: int
    required: true
    description: Particular ADC channel

      
```

## prac0/build/Kconfig/Kconfig.shield.defconfig
```kconfig
osource "/Users/piperhofstee/csse4011/firmware/boards/shields/*/Kconfig.defconfig"
```

## prac0/build/Kconfig/arch/Kconfig
```kconfig
# Load Zephyr Arch Kconfig descriptions.
osource "/Users/piperhofstee/csse4011/zephyr/arch/rx/Kconfig"
osource "/Users/piperhofstee/csse4011/zephyr/arch/x86/Kconfig"
osource "/Users/piperhofstee/csse4011/zephyr/arch/xtensa/Kconfig"
osource "/Users/piperhofstee/csse4011/zephyr/arch/sparc/Kconfig"
osource "/Users/piperhofstee/csse4011/zephyr/arch/riscv/Kconfig"
osource "/Users/piperhofstee/csse4011/zephyr/arch/posix/Kconfig"
osource "/Users/piperhofstee/csse4011/zephyr/arch/mips/Kconfig"
osource "/Users/piperhofstee/csse4011/zephyr/arch/arm64/Kconfig"
osource "/Users/piperhofstee/csse4011/zephyr/arch/arm/Kconfig"
osource "/Users/piperhofstee/csse4011/zephyr/arch/arc/Kconfig"
```
